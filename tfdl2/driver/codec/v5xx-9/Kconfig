## tfdl2/driver/codec/v5xx-9/Kconfig
```kconfig
config MALI_VPU9_DEBUG
	depends on MALI_VPU9
	bool "Mali VPU driver debug"
	default n
	help
		This enabled debug output for the Mali VPU driver

config CONFIG_MALI_VPU9_ENABLE_ALOG
	depends on MALI_VPU9
	bool "Send kernel space logs to Android logd socket."
	default n
	help
		Send kernel space logs to Android logd socket. This option should only be enabled for Android Lollipop or later revisions.

config CONFIG_MALI_VPU9_ENABLE_FTRACE
	depends on MALI_VPU9
	bool "Send kernel space logs to ftrace."
	default n
	help
		Send kernel space logs to ftrace.

config CONFIG_MALI_VPU9_ENABLE_PRINT_FILE
	depends on MALI_VPU9
	bool "Append file and line number to kernel space log messages."
	default n
	help
		Append file and line number to kernel space log messages.

choice
	depends on MALI_VPU9
	prompt "Choose power saving mode"
config MALI_VPU9_POWER_SAVING_MODE_DVFS
	bool "Use DVFS"
config MALI_VPU9_POWER_SAVING_MODE_CLOCK_GATING
	bool "Use HW clock gating"
endchoice

choice
	depends on MALI_VPU9
	prompt "Choose hardware platform"
config MALI_VPU9_VEX6
	bool "Versatile Express 6"
config MALI_VPU9_VEX7
	bool "Versatile Express 7"
config MALI_VPU9_JUNO
	bool "Juno"
endchoice

config MALI_VPU9_DISABLE_WATCHDOG
	depends on MALI_VPU7
	bool "Disable the watchdog"
	default n
	help
		Disable the watchdog that detects frozen video sessions.
```
